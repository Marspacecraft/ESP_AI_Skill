## tests/port/idf/sdkconfig.defaults
```kconfig
# 真机验真用的最小配置：只关心"能不能把结果从串口打出来"。
CONFIG_IDF_TARGET="esp32c3"

# 跑契约套件的那个任务要够用：它要建/收任务、还要 printf。
CONFIG_ESP_MAIN_TASK_STACK_SIZE=8192

# 板子只有一根 USB 线（USB Serial/JTAG），烧录与日志都走它。
CONFIG_ESP_CONSOLE_USB_SERIAL_JTAG=y
CONFIG_ESP_CONSOLE_SECONDARY_NONE=y

# 8 MB Flash，无 PSRAM（与 ai-passport 基线一致）。
CONFIG_ESPTOOLPY_FLASHSIZE_8MB=y
```
